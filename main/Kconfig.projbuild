## main/Kconfig.projbuild
```kconfig
menu "Example Configuration"

    config MESH_CHANNEL
        int "channel"
        range 0 14
        default 0
        help
            mesh network channel.

    config MESH_ROUTER_SSID
        string "Router SSID"
        default "ROUTER_SSID"
        help
            Router SSID.

    config MESH_ROUTER_PASSWD
        string "Router password"
        default "ROUTER_PASSWD"
        help
            Router password.

    choice
        bool "Mesh AP Authentication Mode"
        default WIFI_AUTH_WPA2_PSK
        help
            Authentication mode.

        config WIFI_AUTH_OPEN
            bool "WIFI_AUTH_OPEN"
        config WIFI_AUTH_WPA_PSK
            bool "WIFI_AUTH_WPA_PSK"
        config WIFI_AUTH_WPA2_PSK
            bool "WIFI_AUTH_WPA2_PSK"
        config WIFI_AUTH_WPA_WPA2_PSK
            bool "WIFI_AUTH_WPA_WPA2_PSK"
    endchoice

    config MESH_AP_AUTHMODE
        int
        default 0 if WIFI_AUTH_OPEN
        default 2 if WIFI_AUTH_WPA_PSK
        default 3 if WIFI_AUTH_WPA2_PSK
        default 4 if WIFI_AUTH_WPA_WPA2_PSK
        help
            Mesh AP authentication mode.

    config MESH_AP_PASSWD
        string "Mesh AP Password"
        default "MAP_PASSWD"
        help
            Mesh AP password.

    config MESH_AP_CONNECTIONS
        int "Mesh AP Connections"
        range 1 10
        default 6
        help
            The number of stations allowed to connect in.

    config MESH_MAX_LAYER
        int "Mesh Max Layer"
        range 1 25
        default 6
        help
            Max layer allowed in mesh network.

    config MESH_ROUTE_TABLE_SIZE
        int "Mesh Routing Table Size"
        range 1 300
        default 50
        help
            The number of devices over the network(max: 300).

    config MESH_IE_CRYPTO_KEY
        string "Mesh IE Crypto Key"
        default "hello, esp-mesh."
        help
            Mesh IE ASCII crypto key, length in bytes, range:8~64.

    choice
        bool "Mesh IE Crypto Funcs"
        default IE_CRYPTO_ENABLE
        help
            Mesh IE crypto funcs.

        config IE_CRYPTO_ENABLE
            bool "IE_CRYPTO_ENABLE"
        config IE_CRYPTO_DISABLE
            bool "IE_CRYPTO_DISABLE"
    endchoice

    config MESH_IE_CRYPTO_FUNCS
        int
        default 1 if IE_CRYPTO_ENABLE
        default 0 if IE_CRYPTO_DISABLE
        help
                Mesh IE crypto enable/disable.
endmenu

menu "TCP Configuration"

    choice EXAMPLE_IP_MODE
        prompt "IP Version"
        help
            Example can use either IPV4 or IPV6.

        config EXAMPLE_IPV4
            bool "IPV4"

        config EXAMPLE_IPV6
            bool "IPV6"

    endchoice

    config EXAMPLE_IPV4_ADDR
        string "IPV4 Address"
        default "192.168.0.165"
        depends on EXAMPLE_IPV4
        help
            The example will connect to this IPV4 address.

    config EXAMPLE_IPV6_ADDR
        string "IPV6 Address"
        default "FE80::30AD:E57B:C212:68AD"
        depends on EXAMPLE_IPV6
        help
            The example will connect to this IPV6 address.

    config EXAMPLE_PORT
        int "Port"
        range 0 65535
        default 3333
        help
            The remote port to which the client example will connect to.

endmenu
```
